## sdkconfig.defaults
```kconfig
# Enable performance optimizations, see https://github.com/espressif/esp-bsp/blob/master/components/esp_lvgl_port/docs/performance.md
CONFIG_COMPILER_OPTIMIZATION_PERF=y
# CONFIG_LV_ATTRIBUTE_FAST_MEM_USE_IRAM=y
CONFIG_LV_DEF_REFR_PERIOD=33
CONFIG_FREERTOS_HZ=1000

# Use USB CDC console (equivalent to Arduino USB CDC on boot)
CONFIG_ESP_CONSOLE_USB_CDC=y
CONFIG_ESP_CONSOLE_UART_DEFAULT=n

# Config board
CONFIG_ESPTOOLPY_FLASHSIZE_16MB=y
CONFIG_ESPTOOLPY_FLASHSIZE="16MB"
CONFIG_PARTITION_TABLE_CUSTOM=y
CONFIG_PARTITION_TABLE_CUSTOM_FILENAME="partitions.csv"

# ESP32-S3 specific
CONFIG_IDF_TARGET="esp32s3"
CONFIG_IDF_TARGET_ESP32S3=y

# PSRAM configuration (80 MHz OPI mode for stability)
CONFIG_ESP32S3_SPIRAM_SUPPORT=y
CONFIG_SPIRAM=y
# Use OPI (OCT) mode explicitly instead of AUTO detection
CONFIG_SPIRAM_MODE_OCT=y
CONFIG_SPIRAM_MODE_QUAD=n
CONFIG_SPIRAM_TYPE_AUTO=y
CONFIG_SPIRAM_CLK_IO=30
CONFIG_SPIRAM_CS_IO=26
CONFIG_SPIRAM_SPEED_80M=y
CONFIG_SPIRAM_SPEED_40M=n
CONFIG_SPIRAM_SPEED_26M=n
CONFIG_SPIRAM_SPEED_20M=n
CONFIG_SPIRAM_FETCH_INSTRUCTIONS=y
CONFIG_SPIRAM_RODATA=y
CONFIG_SPIRAM_ALLOW_STACK_EXTERNAL_MEMORY=y
CONFIG_SPIRAM_BOOT_INIT=y
CONFIG_SPIRAM_MEMTEST=y
CONFIG_SPIRAM_USE_MALLOC=y
CONFIG_SPIRAM_MALLOC_ALWAYSINTERNAL=16384
CONFIG_SPIRAM_MALLOC_RESERVE_INTERNAL=32768

# Bluetooth configuration - NimBLE (lightweight, recommended for ESP-IDF)
CONFIG_BT_ENABLED=y
CONFIG_BT_NIMBLE_ENABLED=y
CONFIG_BT_BLUEDROID_ENABLED=n
CONFIG_BT_BLE_ENABLED=y
CONFIG_BT_BREDR_DISABLED=y

# NimBLE Configuration
CONFIG_BT_NIMBLE_ROLE_PERIPHERAL=y
CONFIG_BT_NIMBLE_ROLE_CENTRAL=n
CONFIG_BT_NIMBLE_MAX_CONNECTIONS=1
CONFIG_BT_NIMBLE_PINNED_TO_CORE=0

# NimBLE Memory Optimization
CONFIG_BT_NIMBLE_MEM_ALLOC_MODE_INTERNAL=y
CONFIG_BT_NIMBLE_MAX_BONDS=4
CONFIG_BT_NIMBLE_ACL_BUF_COUNT=12
CONFIG_BT_NIMBLE_ACL_BUF_SIZE=255
CONFIG_BT_NIMBLE_HS_FLOW_CTRL=y
CONFIG_BT_NIMBLE_HS_FLOW_CTRL_ITVL=10
CONFIG_BT_NIMBLE_HS_FLOW_CTRL_THRESH=2

# NimBLE GATT Server
CONFIG_BT_NIMBLE_GATT_SERVER_ENABLED=y
CONFIG_BT_NIMBLE_MAX_ATTRS=80

# LittleFS Configuration
CONFIG_LITTLEFS=y
CONFIG_LITTLEFS_SPIFFS_COMPAT=y
CONFIG_LITTLEFS_PAGE_SIZE=256
CONFIG_LITTLEFS_BLOCK_SIZE=4096
```
